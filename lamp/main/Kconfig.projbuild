## lamp/main/Kconfig.projbuild
```kconfig
menu "Cadence Lamp"

    config LAMP_WIFI_SSID
        string "WiFi SSID"
        default ""

    config LAMP_WIFI_PASSWORD
        string "WiFi password"
        default ""

    config LAMP_PEER_URL
        string "Cadence /peer WebSocket URL"
        default "ws://ianshomeserver:8770/peer"
        help
            The lamp joins Cadence directly as a device peer (no adapter).

    config LAMP_PEER_ID
        string "Peer ID"
        default "bedroom-ceiling"
        help
            Unique per lamp; Cadence rejects a second peer with the same id.

    config LAMP_ROOM
        string "Room"
        default "bedroom"

    config LAMP_OTA_URL
        string "OTA image URL (empty disables)"
        default "http://ianshomeserver:8771/lamp.bin"
        help
            Checked once per boot (power-cycle the wall switch to update).
            Flashed only when the image's ELF SHA-256 differs from the
            running one and from an image that was already rolled back.

endmenu
```

## main/Kconfig.projbuild
```kconfig
menu "Muse Speaker"

    config MUSE_WIFI_SSID
        string "WiFi SSID"
        default ""
        help
            Home WiFi network the ESP32-S3 should join to reach the
            muse_proxy script.

    config MUSE_WIFI_PASSWORD
        string "WiFi password"
        default ""
        help
            Password for MUSE_WIFI_SSID.

    config MUSE_PROXY_URL
        string "muse_proxy stream URL"
        default "http://192.168.0.67:8765/play/3112"
        help
            URL served by tools/muse_proxy.py. Body is raw s16le,
            44100Hz, stereo PCM streamed straight into I2S.

endmenu
```

## voice_chat/main/Kconfig.projbuild
```kconfig
menu "Voice Chat"

    config VOICE_WIFI_SSID
        string "WiFi SSID"
        default ""
        help
            Home WiFi network the ESP32-S3 should join to reach
            tools/voice_chat_host.py.

    config VOICE_WIFI_PASSWORD
        string "WiFi password"
        default ""
        help
            Password for VOICE_WIFI_SSID.

    config VOICE_WS_URL
        string "Cadence session WebSocket URL"
        default "ws://ianshomeserver:8768/session"
        help
            URL of the harness's /session WebSocket endpoint
            (tools/voice_chat_host.py's successor). Carries the
            hello handshake, mic PCM upload, and playback PCM
            download over one bidirectional connection.

    config VOICE_CLIENT_ID
        string "Client ID"
        default "speaker-1"
        help
            Identifies this board in the hello frame sent on
            WebSocket connect.

endmenu
```
